## firmware/components/app_core/Kconfig.projbuild
```kconfig
menu "EtherCAT HMI application"

    config APP_ECAT_CYCLE_US
        int "EtherCAT cycle time (us)"
        range 250 100000
        default 1000

    config APP_ECAT_GO_OP
        bool "Bring slaves to OPERATIONAL and run cyclic process data"
        default y
        help
            When disabled the application scans and compares the topology but stays in PRE-OP.

    config APP_ECAT_MONITOR_PERIOD_MS
        int "Statistics print period (ms)"
        range 200 60000
        default 1000

    config APP_HMI
        bool "Start the LVGL HMI on the 7\" display"
        default y
        help
            Display, touch and LVGL on core 0 (components/hmi). EtherCAT keeps running if the
            display fails to start.

    config APP_ECAT_CONSOLE
        bool "Serial console for topology commands (scan, accept, recheck, ...)"
        default y
        help
            Stands in for SETTING > ETHERCAT until the LVGL HMI exists.

    config APP_TOPOLOGY_AUTO_ACCEPT
        bool "Accept the first scan automatically when no topology is saved (bench use only)"
        default n
        help
            Never enable this on a machine: the expected topology must be confirmed by a person
            (docs/ETHERCAT_PLAN.md section 3.6).

endmenu
```

## firmware/components/board/Kconfig
```kconfig
menu "Board: Guition JC1060P470C_I_W_Y"

    choice BOARD_LCD_PANEL
        prompt "Default LCD panel variant"
        default BOARD_LCD_PANEL_NEW
        help
            The board ships with one of two glass panels behind the same JD9165 driver IC.
            They need different init tables and timing and cannot be detected at run time
            (docs/BOARD.md section 5). A "V2" label on the back means New.
            A wrong choice shows wrong colours or gamma, flickers, or stays black.

            This is only the default: the console command 'panel new|old' stores the
            choice in NVS, so both can be tried without rebuilding.

        config BOARD_LCD_PANEL_NEW
            bool "New panel (V2 label; factory firmware V3.7)"
        config BOARD_LCD_PANEL_OLD
            bool "Old panel (HKC QD070AS01-1; factory firmware V2.x)"
    endchoice

    config BOARD_LCD_DSI_LANE_MBPS
        int "MIPI-DSI lane bit rate (Mbps)"
        range 500 1500
        default 750
        help
            Every vendor source uses 750 Mbps except the xiaozhi "new" board (550).
            Its README suggests trying 550, 750 or 900 if the screen stays dark.

endmenu
```

## firmware/components/camera/Kconfig
```kconfig
menu "Camera stream (components/camera)"

    config CAMERA_HTTP_PORT
        int "HTTP port of the camera server"
        range 1 65535
        default 80
        help
            The server answers on the Wi-Fi address: http://<address>/stream (MJPEG) and
            /snapshot.jpg. Only while the camera is switched on in Settings > Camera.

    config CAMERA_MAX_FPS
        int "Frames per second at most"
        range 1 30
        default 5
        help
            The sensor runs at 30 frames/s; only as many frames as this are compressed and sent.
            Every frame goes over Wi-Fi through the ESP32-C6, which also carries the rest of the
            network traffic, so keep it low (docs/CAMERA.md).

    config CAMERA_JPEG_QUALITY
        int "JPEG quality (10-95)"
        range 10 95
        default 50
        help
            Higher is sharper and larger. The frame size shows in Settings > Camera.

    config CAMERA_HMIRROR
        bool "Mirror the picture left to right"
        default n
        help
            The module's picture is mirrored: text reads backwards (board, 2026-10-13). The PPA
            mirrors it while scaling (not the sensor's mirror bit, which would shift the Bayer order
            the ISP expects). At 1920x1080 this adds a PPA pass over the full picture. Untested.

    config CAMERA_MAX_VIEWERS
        int "Stream connections at most"
        range 1 3
        default 2
        help
            go2rtc on the server takes one and serves every other viewer, so 2 leaves one for a
            browser. Each connection sends every frame again over Wi-Fi.

endmenu
```

## firmware/components/ecat/Kconfig
```kconfig
menu "EtherCAT axes"

    config ECAT_PATH
        bool "Two-axis interpolation in CSP (Manual > Interpolation, console 'path')"
        default n
        help
            Lines and arcs on two axes in cyclic synchronous position (6060 = 8), with the targets
            computed by the cyclic task. Off because the machine needs Profile Position only
            (CLAUDE.md, 2026-10-31): without it the cyclic task runs PP, PV and homing only, and
            the Manual page has no Interpolation view. Turn it on to test interpolation again.
            Still Free Run without DC: whether the drives accept CSP that way is unverified
            (docs/SLAVES_LEADSHINE.md section 6).

endmenu
```

## firmware/components/hmi/Kconfig
```kconfig
menu "HMI (LVGL)"

    config HMI_MACHINE_NAME
        string "Machine name in the title bar"
        default "[MACHINE NAME]"

    config HMI_ACCENT_COLOR
        hex "Accent colour (0xRRGGBB)"
        default 0x107C41
        help
            Green as in the reference screenshot. 0x005FB8 is the Windows default blue,
            which keeps the accent apart from the green "running/OK" status colour.

    config HMI_DEMO_DATA
        bool "Show the mockup's demo values"
        default y
        help
            There is no machine logic yet. With this option the Main page shows the values of
            the mockup (marked "demo data" in the page header), and the mode/Start/Stop buttons
            only change what is displayed. Without it, values read "—".

    config HMI_TASK_PRIORITY
        int "LVGL task priority (core 0)"
        range 1 18
        default 4
        help
            Must stay below the EtherCAT tasks. The LVGL task is pinned to core 0.

    config HMI_BRIGHTNESS
        int "Backlight brightness (%)"
        range 5 100
        default 80

    config HMI_DIM_AFTER_S
        int "Dim the screen after (s without a touch, 0 = never)"
        range 0 3600
        default 120
        help
            Default until Settings > System saves another value.

    config HMI_OFF_AFTER_S
        int "Switch the screen off after (s without a touch, 0 = never)"
        range 0 3600
        default 600
        help
            Default until Settings > System saves another value. Counted from the last touch,
            like the dim timeout.

    config HMI_DIM_LEVEL
        int "Dimmed backlight (% of the set brightness)"
        range 5 90
        default 20

    config HMI_BG_LEVEL
        int "Background grey (% of white)"
        range 50 100
        default 80
        help
            Solid grey behind the white cards, in % of white: 80 gives #CCCCCC (user's choice,
            2026-10-10). The backlight is set separately (Settings > System).

endmenu
```

## firmware/components/soem/Kconfig
```kconfig
menu "SOEM EtherCAT master"

    config SOEM_MAXSLAVE
        int "Maximum number of slaves"
        range 1 200
        default 32
        help
            Size of the slave list. Each entry costs roughly 0.5 KB of RAM.

    config SOEM_MAXGROUP
        int "Maximum number of slave groups"
        range 1 8
        default 2

    config SOEM_MAXBUF
        int "Frame buffers per channel"
        range 4 32
        default 16
        help
            Number of frames that can be in flight at once (TX + RX buffers each).

    config SOEM_MBXPOOLSIZE
        int "Mailboxes in pool"
        range 4 64
        default 16
        help
            Each mailbox is about 1.5 KB.

    config SOEM_TIMEOUTRET_US
        int "Frame return timeout (us)"
        range 200 20000
        default 2000
        help
            Time to wait for a sent frame to come back before giving up.

    config SOEM_RX_QUEUE_LEN
        int "EMAC to SOEM RX queue length (frames)"
        range 4 128
        default 32

    config SOEM_RT_CORE
        int "Core for real-time threads"
        range 0 1
        default 1
        help
            Core used by osal_thread_create_rt(). Ethernet and the EtherCAT cycle should
            run on this core; LVGL and Wi-Fi on the other one.

    config SOEM_RT_TASK_PRIO
        int "Priority of real-time threads"
        range 1 24
        default 19
        help
            Keep it below the EMAC RX task priority on the same core.

    config SOEM_WORKER_TASK_PRIO
        int "Priority of worker threads"
        range 1 24
        default 5

    config SOEM_DEBUG
        bool "Enable SOEM debug prints (EC_DEBUG)"
        default n

endmenu
```
